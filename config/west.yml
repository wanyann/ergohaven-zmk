## config/west.yml
```yaml
manifest:
  remotes:
    - name: zmkfirmware
      url-base: https://github.com/zmkfirmware
    - name: ergohaven
      url-base: https://github.com/ergohaven
    - name: wanyann
      url-base: https://github.com/wanyann
    - name: kot149
      url-base: https://github.com/kot149
    - name: hsgw
      url-base: https://github.com/hsgw
    - name: badjeff
      url-base: https://github.com/badjeff
    - name: urob
      url-base: https://github.com/urob
  projects:
    - name: zmk
      remote: wanyann
      revision: v0.3.0 # v0.3.0
      import: app/west.yml
    - name: zmk-pmw3610-driver
      remote: ergohaven
      revision: eh
    - name: ergohaven-zmk-qube
      remote: wanyann
      revision: eh
    - name: zmk-raw-hid
      remote: ergohaven
      revision: main
    - name: zmk-scroll-snap
      remote: kot149
      revision: v1
    - name: zmk-feature-sensor_rotation
      remote: hsgw
      revision: e1a0186220ade99220d04dadf9735b758cfdf086
    - name: zmk-behavior-mouse-key-toggle
      remote: badjeff
      revision: main
  self:
    path: config
```
