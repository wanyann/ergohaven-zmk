## boards/shields/imperial44/Kconfig.defconfig
```kconfig
if SHIELD_IMPERIAL44_QUBE || SHIELD_IMPERIAL44_LEFT

config ZMK_KEYBOARD_NAME
    default "EH Imperial44"

config ZMK_SPLIT_ROLE_CENTRAL
    default y

endif

if SHIELD_IMPERIAL44_QUBE || SHIELD_IMPERIAL44_LEFT_QUBE || SHIELD_IMPERIAL44_LEFT || SHIELD_IMPERIAL44_RIGHT

config ZMK_SPLIT
    default y

config ZMK_POINTING
    default y

endif
```

## boards/shields/imperial44/Kconfig.shield
```kconfig
config SHIELD_IMPERIAL44_LEFT_QUBE
    def_bool $(shields_list_contains,imperial44_left_qube)

config SHIELD_IMPERIAL44_QUBE
    def_bool $(shields_list_contains,imperial44_qube)

config SHIELD_IMPERIAL44_LEFT
    def_bool $(shields_list_contains,imperial44_left)

config SHIELD_IMPERIAL44_RIGHT
    def_bool $(shields_list_contains,imperial44_right)
```

## boards/shields/k03/Kconfig.shield
```kconfig
config SHIELD_K03_LEFT_DONGLE
    def_bool $(shields_list_contains,k03_left_dongle)

config SHIELD_K03_DONGLE
    def_bool $(shields_list_contains,k03_dongle)

config SHIELD_K03_LEFT
    def_bool $(shields_list_contains,k03_left)

config SHIELD_K03_RIGHT
    def_bool $(shields_list_contains,k03_right)
```

## boards/shields/op36/Kconfig.shield
```kconfig
config SHIELD_OP36_LEFT_DONGLE
    def_bool $(shields_list_contains,op36_left_dongle)

config SHIELD_OP36_DONGLE
    def_bool $(shields_list_contains,op36_dongle)

config SHIELD_OP36_LEFT
    def_bool $(shields_list_contains,op36_left)

config SHIELD_OP36_RIGHT
    def_bool $(shields_list_contains,op36_right)
```

## boards/shields/sprawl/Kconfig.defconfig
```kconfig
if SHIELD_SPRAWL_QUBE || SHIELD_SPRAWL_LEFT

config ZMK_KEYBOARD_NAME
    default "EH Sprawl"

config ZMK_SPLIT_ROLE_CENTRAL
    default y

endif

if SHIELD_SPRAWL_QUBE || SHIELD_SPRAWL_LEFT_QUBE || SHIELD_SPRAWL_LEFT || SHIELD_SPRAWL_RIGHT

config ZMK_SPLIT
    default y

config ZMK_POINTING
    default y

endif
```

## boards/shields/sprawl/Kconfig.shield
```kconfig
config SHIELD_SPRAWL_LEFT_QUBE
    def_bool $(shields_list_contains,sprawl_left_qube)

config SHIELD_SPRAWL_QUBE
    def_bool $(shields_list_contains,sprawl_qube)

config SHIELD_SPRAWL_LEFT
    def_bool $(shields_list_contains,sprawl_left)

config SHIELD_SPRAWL_RIGHT
    def_bool $(shields_list_contains,sprawl_right)
```

## boards/shields/trackball/Kconfig.defconfig
```kconfig
if SHIELD_TRACKBALL

config ZMK_KEYBOARD_NAME
    default "EH TB Mini v3"

config ZMK_SPLIT
    default n

config ZMK_SPLIT_ROLE_CENTRAL
    default y

config ZMK_POINTING
    default y

endif
```
